## Build-systems/yocto/tempmon/meta-tempmon/conf/layer.conf
```bitbake
# We have a conf and classes directory, add to BBPATH
BBPATH .= ":${LAYERDIR}"

# We have recipes-* directories, add to BBFILES
BBFILES += "${LAYERDIR}/recipes-*/*/*.bb \
            ${LAYERDIR}/recipes-*/*/*.bbappend"

BBFILE_COLLECTIONS += "meta-tempmon"
BBFILE_PATTERN_meta-tempmon = "^${LAYERDIR}/"
BBFILE_PRIORITY_meta-tempmon = "6"

LAYERDEPENDS_meta-tempmon = "core"
LAYERSERIES_COMPAT_meta-tempmon = "kirkstone"
```
